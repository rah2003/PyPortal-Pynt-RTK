// Web config GUI (ENABLE_WEB_CONFIG, pynt-rover-coex only). W1+W2 scope:
// GET / (gzipped SPA from PROGMEM), GET /api/status, W2 WiFi
// provisioning (GET/POST /api/wifi, GET /api/scan, POST /api/reboot)
// and the on-demand AP mode; W3-W5 routes remain 501 scaffolds.
//
// Concurrency model (docs/web-config-spike.md): the server is the
// LOWEST-priority superloop resident. Hand-rolled HTTP/1.1 state
// machine over WiFiServer/WiFiClient — one connection at a time,
// Connection: close, and at most ONE bounded read or write per loop
// pass so a slow phone can never stall the correction path. accept()
// (not available()) so browsers mid-handshake are picked up instantly.
//
// AP provisioning mode (W2, entered ONLY by the TFT AP button):
//   enter = WiFi.end() -> beginAP(<hostname>-setup, apPass). This is
//   the exact W0-proven sequence; W0 also proved WiFi.end() WEDGES any
//   later STA join until the module resets, so the ONLY exit is
//   save-then-reboot (NVIC_SystemReset -> SpiDrv's boot-time RESETN
//   pulse gives the module a clean start). ntripPoll stands down while
//   the AP is active; BLE keeps running (W0.6: AP+BLE coexist).
//
// Auth: HTTP Basic, user "admin", password g_settings.adminPass —
// generated from the SAMD51 TRNG at first web boot if unset (no
// hardcoded default), shown on the TFT WEB page. The expected header
// is recomputed per request, so a password change applies instantly.
#include "web_config.h"

#include "features.h"

#if ENABLE_WEB_CONFIG

#include <WiFiNINA.h>

#include "gnss.h"
#include "ntrip.h"
#include "sd_logger.h"
#include "settings.h"
#include "shared.h"
#include "web_assets.h"  // generated by tools/webui/build_assets.py

namespace {

WiFiServer* server = nullptr;
bool serverUp = false;
WiFiClient conn;

enum class HttpState : uint8_t { Idle, ReadRequest, ReadBody, Respond };
HttpState state = HttpState::Idle;
uint32_t stateEnteredMs = 0;
constexpr uint32_t kRequestTimeoutMs = 2000;
constexpr uint32_t kResponseTimeoutMs = 8000;

// Request scratch.
char reqLine[128];
size_t reqLen = 0;
bool reqLineDone = false;
char hdrLine[160];
size_t hdrLen = 0;
bool authOk = false;
size_t contentLen = 0;
char body[320];
size_t bodyLen = 0;

// Response streaming (one bounded chunk per pass).
const uint8_t* rspBody = nullptr;
size_t rspBodyLen = 0, rspBodySent = 0;
char rspHead[224];
size_t rspHeadLen = 0, rspHeadSent = 0;
char jsonBuf[900];  // status JSON / wifi list / scan results
constexpr size_t kChunk = 1024;

// AP provisioning mode (W2).
bool apActive = false;
char apSsid[41] = {0};
uint32_t rebootAtMs = 0;  // nonzero = reboot pending (response drains first)

// Scan cache. scanNetworks() is radioactive on this fw whenever a
// network is live — it drops an STA association AND stops the AP
// beaconing without recovery (bench 2026-07-31, st stuck at
// WL_SCAN_COMPLETED). The only safe window is the AP-entry boot,
// BEFORE beginAP(): radio idle, nothing to kill. Scan once there,
// serve the cache from /api/scan, never scan live.
constexpr uint8_t kScanMax = 12;
struct ScanEntry { char ssid[33]; int16_t rssi; uint8_t enc; };
ScanEntry scanCache[kScanMax];
uint8_t scanCount = 0;
bool scanDone = false;

// --- SAMD51 TRNG ------------------------------------------------------
uint32_t trng32() {
#ifdef __SAMD51__
  // Bounded wait: DATARDY is due after 84 APB cycles, so 100k spins is
  // orders of magnitude past "working" — a miss means the peripheral
  // isn't running (clock/errata) and we degrade instead of hanging boot.
  MCLK->APBCMASK.bit.TRNG_ = 1;
  TRNG->CTRLA.bit.ENABLE = 1;
  for (uint32_t i = 0; i < 100000; i++) {
    if (TRNG->INTFLAG.bit.DATARDY) return TRNG->DATA.reg;
  }
  Serial.println(F("[web] TRNG timeout — weak-entropy fallback"));
#endif
  return micros() ^ ((uint32_t)analogRead(A0) << 16) ^ (millis() << 8);
}

void genPassword(char* dst, size_t len) {
  // Unambiguous alphabet (no 0/O/1/l/I) — read off a 240x320 TFT.
  static const char tbl[] = "23456789abcdefghjkmnpqrstuvwxyzABCDEFGHJKMNPQRSTUVWXYZ";
  for (size_t i = 0; i < len; i++) dst[i] = tbl[trng32() % (sizeof(tbl) - 1)];
  dst[len] = '\0';
}

void base64enc(const char* in, char* out, size_t outLen) {  // as ntrip.cpp
  static const char tbl[] =
      "ABCDEFGHIJKLMNOPQRSTUVWXYZabcdefghijklmnopqrstuvwxyz0123456789+/";
  size_t n = strlen(in), o = 0;
  for (size_t i = 0; i < n && o + 4 < outLen; i += 3) {
    uint32_t v = (uint32_t)(uint8_t)in[i] << 16 |
                 (i + 1 < n ? (uint32_t)(uint8_t)in[i + 1] << 8 : 0) |
                 (i + 2 < n ? (uint32_t)(uint8_t)in[i + 2] : 0);
    out[o++] = tbl[(v >> 18) & 63];
    out[o++] = tbl[(v >> 12) & 63];
    out[o++] = (i + 1 < n) ? tbl[(v >> 6) & 63] : '=';
    out[o++] = (i + 2 < n) ? tbl[v & 63] : '=';
  }
  out[o] = '\0';
}

bool authHeaderMatches(const char* value) {
  // Recomputed per request: a changed admin password applies instantly.
  char creds[40], b64[56], expected[64];
  snprintf(creds, sizeof(creds), "admin:%s", g_settings.adminPass);
  base64enc(creds, b64, sizeof(b64));
  snprintf(expected, sizeof(expected), "Basic %s", b64);
  return strcmp(value, expected) == 0;
}

// --- tiny urlencoded-form parser --------------------------------------
int hexVal(char c) {
  if (c >= '0' && c <= '9') return c - '0';
  if (c >= 'a' && c <= 'f') return c - 'a' + 10;
  if (c >= 'A' && c <= 'F') return c - 'A' + 10;
  return -1;
}

void urldecode(char* s) {
  char* w = s;
  for (char* r = s; *r; r++) {
    if (*r == '+') { *w++ = ' '; continue; }
    if (*r == '%' && hexVal(r[1]) >= 0 && hexVal(r[2]) >= 0) {
      *w++ = (char)(hexVal(r[1]) * 16 + hexVal(r[2]));
      r += 2;
      continue;
    }
    *w++ = *r;
  }
  *w = '\0';
}

// Find key= in an urlencoded body; copies decoded value.
bool formField(const char* form, const char* key, char* out, size_t cap) {
  size_t klen = strlen(key);
  const char* p = form;
  out[0] = '\0';
  while (p && *p) {
    if (!strncmp(p, key, klen) && p[klen] == '=') {
      const char* v = p + klen + 1;
      const char* e = strchr(v, '&');
      size_t n = e ? (size_t)(e - v) : strlen(v);
      if (n >= cap) n = cap - 1;
      memcpy(out, v, n);
      out[n] = '\0';
      urldecode(out);
      return true;
    }
    p = strchr(p, '&');
    if (p) p++;
  }
  return false;
}

// --- response builders ------------------------------------------------
void startResponse(const char* status, const char* type, const char* extra,
                   const uint8_t* bodyPtr, size_t bodyN) {
  rspHeadLen = (size_t)snprintf(
      rspHead, sizeof(rspHead),
      "HTTP/1.1 %s\r\nContent-Type: %s\r\nContent-Length: %u\r\n"
      "Cache-Control: no-store\r\nConnection: close\r\n%s\r\n",
      status, type, (unsigned)bodyN, extra ? extra : "");
  rspHeadSent = 0;
  rspBody = bodyPtr;
  rspBodyLen = bodyN;
  rspBodySent = 0;
  state = HttpState::Respond;
  stateEnteredMs = millis();
}

void respondJson(const char* status, int n) {
  // Team review L1: callers pass snprintf's return, which is what WOULD
  // have been written — clamp so a grown status string can never leak
  // adjacent BSS onto the wire.
  if (n < 0) n = 0;
  if (n >= (int)sizeof(jsonBuf)) n = sizeof(jsonBuf) - 1;
  startResponse(status, "application/json", nullptr, (const uint8_t*)jsonBuf,
                (size_t)n);
}

void respond401() {
  static const char kBody[] = "{\"err\":\"auth\"}";
  startResponse("401 Unauthorized", "application/json",
                "WWW-Authenticate: Basic realm=\"pynt-rtk\"\r\n",
                (const uint8_t*)kBody, sizeof(kBody) - 1);
}

void respond404() {
  static const char kBody[] = "{\"err\":\"no such route\"}";
  startResponse("404 Not Found", "application/json", nullptr,
                (const uint8_t*)kBody, sizeof(kBody) - 1);
}

void respond501(const char* what) {
  int n = snprintf(jsonBuf, sizeof(jsonBuf),
                   "{\"err\":\"%s not implemented yet\"}", what);
  respondJson("501 Not Implemented", n);
}

void respondStatusJson() {
  uint32_t age = correctionAgeMs();
  long corrS = (age == UINT32_MAX) ? -1 : (long)(age / 1000);
  uint8_t ble = 0;
#if FEATURE_BLE
  ble = !g_link.bleUp        ? 0
        : g_link.bleSubscribed ? 3
        : g_link.bleConnected  ? 2
                               : 1;
#endif
  const char* fn = g_log.fileName[0]
                       ? (strrchr(g_log.fileName, '/')
                              ? strrchr(g_log.fileName, '/') + 1
                              : g_log.fileName)
                       : "";
  int n = snprintf(
      jsonBuf, sizeof(jsonBuf),
      "{\"fix\":%u,\"carr\":%u,\"sv\":%u,\"lat\":%.7f,\"lon\":%.7f,"
      "\"alt\":%.1f,\"hacc\":%lu,\"pdop\":%.1f,\"ntrip\":\"%s\","
      "\"corr\":%ld,\"rssi\":%d,\"ip\":\"%s\",\"ssid\":\"%s\",\"tcp\":%u,"
      "\"ble\":%u,\"sd\":%d,\"file\":\"%s\",\"kb\":%lu,\"freemb\":%lu,"
      "\"up\":%lu,\"mode\":\"%s\",\"ap\":%d}",
      g_gnss.fixType, g_gnss.carrSoln, g_gnss.numSV, g_gnss.latDeg,
      g_gnss.lonDeg, g_gnss.hMslM, (unsigned long)g_gnss.hAccMm,
      g_gnss.pdop, ntripStateName(), corrS, g_link.wifiRssi,
      apActive ? "192.168.4.1" : g_link.wifiIp,
      apActive ? apSsid : (g_link.wifiUp ? WiFi.SSID() : ""),
      g_link.tcpClients, ble, g_log.sdOk ? 1 : 0, fn,
      (unsigned long)(g_log.bytesWritten / 1024),
      (unsigned long)(g_log.sdFreeKB / 1024), (unsigned long)(millis() / 1000),
      g_settings.mode == DeviceMode::Base ? "base" : "rover", apActive ? 1 : 0);
  respondJson("200 OK", n);
}

void respondWifiListJson() {
  int n = snprintf(jsonBuf, sizeof(jsonBuf), "{\"slots\":[");
  for (int i = 0; i < kMaxWifiNetworks; i++) {
    n += snprintf(jsonBuf + n, sizeof(jsonBuf) - n,
                  "%s{\"slot\":%d,\"ssid\":\"%s\",\"set\":%d}", i ? "," : "",
                  i + 1, g_settings.wifiSsid[i],
                  g_settings.wifiSsid[i][0] ? 1 : 0);
    // Clamp between appends (L1): past the end, `jsonBuf + n` is OOB and
    // `sizeof - n` underflows to a huge size_t.
    if (n >= (int)sizeof(jsonBuf)) n = sizeof(jsonBuf) - 1;
  }
  n += snprintf(jsonBuf + n, sizeof(jsonBuf) - n,
                "],\"connected\":\"%s\",\"ip\":\"%s\",\"ap\":%d,"
                "\"apssid\":\"%s\"}",
                (!apActive && g_link.wifiUp) ? WiFi.SSID() : "",
                g_link.wifiIp, apActive ? 1 : 0, apSsid);
  respondJson("200 OK", n);
}

void handleWifiPost() {
  char slotStr[8], ssid[33], pass[65];
  formField(body, "slot", slotStr, sizeof(slotStr));
  bool haveSsid = formField(body, "ssid", ssid, sizeof(ssid));
  bool havePass = formField(body, "pass", pass, sizeof(pass));
  int slot = atoi(slotStr);
  if (slot < 1 || slot > kMaxWifiNetworks || !haveSsid) {
    int n = snprintf(jsonBuf, sizeof(jsonBuf),
                     "{\"err\":\"need slot=1..%d and ssid\"}", kMaxWifiNetworks);
    respondJson("400 Bad Request", n);
    return;
  }
  // Empty ssid clears the slot; empty/absent pass = open network.
  strncpy(g_settings.wifiSsid[slot - 1], ssid, 32);
  g_settings.wifiSsid[slot - 1][32] = '\0';
  strncpy(g_settings.wifiPass[slot - 1], havePass ? pass : "", 64);
  g_settings.wifiPass[slot - 1][64] = '\0';
  bool saved = settingsSave();
  Serial.print(F("[web] wifi slot "));
  Serial.print(slot);
  Serial.println(ssid[0] ? F(" updated") : F(" cleared"));
  int n = snprintf(jsonBuf, sizeof(jsonBuf), "{\"ok\":1,\"saved\":%d}",
                   saved ? 1 : 0);
  respondJson("200 OK", n);
}

void scanIntoCache() {
  // ONLY callable while the radio is idle (AP-entry boot, pre-beginAP).
  Serial.println(F("[web] pre-AP scan..."));
  int8_t count = WiFi.scanNetworks();
  scanCount = 0;
  for (int8_t i = 0; i < count && scanCount < kScanMax; i++) {
    const char* s = WiFi.SSID(i);
    if (!s || !s[0]) continue;
    if (strchr(s, '"') || strchr(s, '\\')) continue;  // crude JSON safety
    strncpy(scanCache[scanCount].ssid, s, 32);
    scanCache[scanCount].ssid[32] = '\0';
    scanCache[scanCount].rssi = (int16_t)WiFi.RSSI(i);
    scanCache[scanCount].enc = (uint8_t)WiFi.encryptionType(i);
    scanCount++;
  }
  scanDone = true;
  Serial.print(F("[web] cached "));
  Serial.print(scanCount);
  Serial.println(F(" networks"));
}

void respondScanJson() {
  if (!scanDone) {
    // No live scan ever: it kills whatever network is up (see cache
    // comment). The cache fills at AP-entry boot only.
    int n = snprintf(jsonBuf, sizeof(jsonBuf),
                     "{\"err\":\"scan runs when setup mode starts — enter"
                     " setup (AP) mode to get a fresh list\"}");
    respondJson("409 Conflict", n);
    return;
  }
  int n = snprintf(jsonBuf, sizeof(jsonBuf), "{\"nets\":[");
  for (uint8_t i = 0; i < scanCount; i++) {
    int add = snprintf(jsonBuf + n, sizeof(jsonBuf) - n,
                       "%s{\"ssid\":\"%s\",\"rssi\":%d,\"enc\":%u}",
                       i ? "," : "", scanCache[i].ssid, scanCache[i].rssi,
                       scanCache[i].enc);
    if (n + add >= (int)sizeof(jsonBuf) - 24) break;
    n += add;
  }
  n += snprintf(jsonBuf + n, sizeof(jsonBuf) - n, "]}");
  respondJson("200 OK", n);
}

// ---- W3: GNSS + Corrections cards ------------------------------------
void respondGnssJson() {
  int n = snprintf(jsonBuf, sizeof(jsonBuf),
                   "{\"measrate\":%u,\"dynmodel\":%u,\"gsv\":%d,"
                   "\"elevmask\":%u,\"mode\":\"%s\"}",
                   g_settings.measRateHz, g_settings.dynModel,
                   g_settings.nmeaGsv ? 1 : 0, g_settings.elevMaskDeg,
                   g_settings.mode == DeviceMode::Base ? "base" : "rover");
  respondJson("200 OK", n);
}

void handleGnssPost() {
  char v[12];
  if (formField(body, "measrate", v, sizeof(v))) {
    int hz = atoi(v);
    if (hz >= 1 && hz <= 5) g_settings.measRateHz = (uint8_t)hz;
  }
  if (formField(body, "dynmodel", v, sizeof(v))) {
    int m = atoi(v);
    // F9P-sane platform models: 0 portable, 2 stationary, 3 pedestrian,
    // 4 automotive, 5 sea, 6 airborne-1g.
    if (m == 0 || (m >= 2 && m <= 6)) g_settings.dynModel = (uint8_t)m;
  }
  if (formField(body, "gsv", v, sizeof(v))) g_settings.nmeaGsv = atoi(v) != 0;
  if (formField(body, "elevmask", v, sizeof(v))) {
    int e = atoi(v);
    if (e >= 0 && e <= 45) g_settings.elevMaskDeg = (uint8_t)e;
  }
  bool saved = settingsSave();
  gnssRequestModeApply();  // full VALSET re-apply on the next gnss poll
  Serial.println(F("[web] gnss settings applied"));
  int n = snprintf(jsonBuf, sizeof(jsonBuf),
                   "{\"ok\":1,\"saved\":%d,\"applied\":1}", saved ? 1 : 0);
  respondJson("200 OK", n);
}

void respondNtripJson() {
  uint32_t age = correctionAgeMs();
  long corrS = (age == UINT32_MAX) ? -1 : (long)(age / 1000);
  int n = snprintf(
      jsonBuf, sizeof(jsonBuf),
      "{\"caster\":\"%s\",\"port\":%u,\"mount\":\"%s\",\"user\":\"%s\","
      "\"passset\":%d,\"gga\":%u,\"state\":\"%s\",\"corr\":%ld,"
      "\"rtcmkb\":%lu}",
      g_settings.casterHost, g_settings.casterPort, g_settings.casterMount,
      g_settings.casterUser, g_settings.casterPass[0] ? 1 : 0,
      g_settings.ggaPeriodS, ntripStateName(), corrS,
      (unsigned long)(g_link.rtcmBytes / 1024));
  respondJson("200 OK", n);
}

void handleNtripPost() {
  char v[65];
  if (formField(body, "caster", v, sizeof(v)) && v[0]) {
    strncpy(g_settings.casterHost, v, 64);
    g_settings.casterHost[64] = '\0';
  }
  if (formField(body, "port", v, sizeof(v)) && v[0]) {
    long p = atol(v);
    if (p > 0 && p <= 65535) g_settings.casterPort = (uint16_t)p;
  }
  if (formField(body, "mount", v, sizeof(v))) {
    strncpy(g_settings.casterMount, v, 48);
    g_settings.casterMount[48] = '\0';
  }
  if (formField(body, "user", v, sizeof(v))) {
    strncpy(g_settings.casterUser, v, 48);
    g_settings.casterUser[48] = '\0';
  }
  // Blank/absent password = keep the existing one (it's never echoed).
  if (formField(body, "pass", v, sizeof(v)) && v[0]) {
    strncpy(g_settings.casterPass, v, 48);
    g_settings.casterPass[48] = '\0';
  }
  if (formField(body, "gga", v, sizeof(v)) && v[0]) {
    int s = atoi(v);
    if (s >= 1 && s <= 120) g_settings.ggaPeriodS = (uint16_t)s;
  }
  bool saved = settingsSave();
  ntripRequestReconnect();  // pick up the new caster promptly
  Serial.println(F("[web] ntrip settings applied, reconnecting"));
  int n = snprintf(jsonBuf, sizeof(jsonBuf),
                   "{\"ok\":1,\"saved\":%d,\"reconnecting\":1}", saved ? 1 : 0);
  respondJson("200 OK", n);
}

// ---- W4: Logging card ------------------------------------------------
void respondLogJson() {
  const char* fn = g_log.fileName[0]
                       ? (strrchr(g_log.fileName, '/')
                              ? strrchr(g_log.fileName, '/') + 1
                              : g_log.fileName)
                       : "";
  int n = snprintf(jsonBuf, sizeof(jsonBuf),
                   "{\"enabled\":%d,\"open\":%d,\"file\":\"%s\",\"kb\":%lu,"
                   "\"freemb\":%lu,\"bufhw\":%lu,\"sd\":%d}",
                   g_log.loggingEnabled ? 1 : 0, g_log.fileOpen ? 1 : 0, fn,
                   (unsigned long)(g_log.bytesWritten / 1024),
                   (unsigned long)(g_log.sdFreeKB / 1024),
                   (unsigned long)g_log.bufHighWater, g_log.sdOk ? 1 : 0);
  respondJson("200 OK", n);
}

void handleLogPost() {
  char v[8];
  if (formField(body, "log", v, sizeof(v))) {
    bool on = atoi(v) != 0;
    sdLoggerSetEnabled(on);       // same path as the LOG touch button
    g_settings.logUbx = on;       // and persist as the boot default
    settingsSave();
    Serial.println(on ? F("[web] logging on") : F("[web] logging off"));
  }
  respondLogJson();
}

// ---- W5: BLE + System cards ------------------------------------------
void respondBleJson() {
#if FEATURE_BLE
  int n = snprintf(jsonBuf, sizeof(jsonBuf),
                   "{\"enabled\":%d,\"name\":\"%s\",\"up\":%d,\"conn\":%d,"
                   "\"stream\":%d,\"tx\":%lu,\"drops\":%lu}",
                   g_settings.bleEnable ? 1 : 0, g_settings.bleName,
                   g_link.bleUp ? 1 : 0, g_link.bleConnected ? 1 : 0,
                   g_link.bleSubscribed ? 1 : 0,
                   (unsigned long)g_link.bleLinesTx,
                   (unsigned long)g_link.bleDrops);
#else
  int n = snprintf(jsonBuf, sizeof(jsonBuf), "{\"err\":\"no BLE in this build\"}");
#endif
  respondJson("200 OK", n);
}

void handleBlePost() {
#if FEATURE_BLE
  char v[26];
  if (formField(body, "enable", v, sizeof(v)))
    g_settings.bleEnable = atoi(v) != 0;
  if (formField(body, "name", v, sizeof(v)) && v[0]) {
    strncpy(g_settings.bleName, v, 24);
    g_settings.bleName[24] = '\0';
  }
  bool saved = settingsSave();
  // ArduinoBLE has no clean re-init on this transport; name/enable
  // changes apply at the next boot (the card says so).
  int n = snprintf(jsonBuf, sizeof(jsonBuf),
                   "{\"ok\":1,\"saved\":%d,\"restart\":1}", saved ? 1 : 0);
  respondJson("200 OK", n);
#else
  respond404();
#endif
}

void respondSystemJson() {
  int n = snprintf(
      jsonBuf, sizeof(jsonBuf),
      "{\"hostname\":\"%s\",\"port\":%u,\"up\":%lu,\"build\":\"%s %s\","
      "\"apssid\":\"%s\"}",
      g_settings.hostname, g_settings.webPort,
      (unsigned long)(millis() / 1000), __DATE__, __TIME__, apSsid);
  respondJson("200 OK", n);
}

void handleSystemPost() {
  char v[33];
  bool authChanged = false;
  if (formField(body, "hostname", v, sizeof(v)) && v[0]) {
    strncpy(g_settings.hostname, v, 32);
    g_settings.hostname[32] = '\0';
    snprintf(apSsid, sizeof(apSsid), "%s-setup", g_settings.hostname);
    WiFi.setHostname(g_settings.hostname);  // takes effect on next join
  }
  if (formField(body, "adminpass", v, sizeof(v)) && v[0]) {
    strncpy(g_settings.adminPass, v, 16);
    g_settings.adminPass[16] = '\0';
    authChanged = true;  // per-request recompute: instant
  }
  if (formField(body, "appass", v, sizeof(v)) && v[0]) {
    if (strlen(v) >= 8) {  // WPA2 minimum
      strncpy(g_settings.apPass, v, 16);
      g_settings.apPass[16] = '\0';
    }
  }
  if (formField(body, "regen", v, sizeof(v)) && atoi(v)) {
    genPassword(g_settings.adminPass, 10);
    genPassword(g_settings.apPass, 10);
    authChanged = true;
    Serial.println(F("[web] passwords regenerated (TFT WEB page shows them)"));
  }
  bool saved = settingsSave();
  int n = snprintf(jsonBuf, sizeof(jsonBuf),
                   "{\"ok\":1,\"saved\":%d,\"reauth\":%d}", saved ? 1 : 0,
                   authChanged ? 1 : 0);
  respondJson("200 OK", n);
}

// --- routing ----------------------------------------------------------
void route() {
  char* path = strchr(reqLine, ' ');
  if (!path) { respond404(); return; }
  *path++ = '\0';
  char* end = strchr(path, ' ');
  if (end) *end = '\0';
  const bool isGet = !strcmp(reqLine, "GET");
  const bool isPost = !strcmp(reqLine, "POST");

  if (!authOk) { respond401(); return; }

  if (isGet && (!strcmp(path, "/") || !strcmp(path, "/index.html"))) {
    startResponse("200 OK", "text/html; charset=utf-8",
                  "Content-Encoding: gzip\r\n", WEB_INDEX_GZ,
                  WEB_INDEX_GZ_LEN);
    return;
  }
  if (isGet && !strcmp(path, "/api/status")) { respondStatusJson(); return; }

  // ---- W2: WiFi provisioning ----
  if (!strcmp(path, "/api/wifi")) {
    if (isGet) { respondWifiListJson(); return; }
    if (isPost) { handleWifiPost(); return; }
  }
  if (isGet && !strcmp(path, "/api/scan")) { respondScanJson(); return; }
  if (isPost && !strcmp(path, "/api/reboot")) {
    rebootAtMs = millis() + 700;  // let the response drain first
    Serial.println(F("[web] reboot requested"));
    int n = snprintf(jsonBuf, sizeof(jsonBuf), "{\"ok\":1,\"rebooting\":1}");
    respondJson("200 OK", n);
    return;
  }

  // ---- W3: GNSS + Corrections ----
  if (!strcmp(path, "/api/gnss")) {
    if (isGet) { respondGnssJson(); return; }
    if (isPost) { handleGnssPost(); return; }
  }
  if (!strcmp(path, "/api/ntrip")) {
    if (isGet) { respondNtripJson(); return; }
    if (isPost) { handleNtripPost(); return; }
  }

  // ---- W4: Logging ----
  if (!strcmp(path, "/api/log")) {
    if (isGet) { respondLogJson(); return; }
    if (isPost) { handleLogPost(); return; }
  }
  // ---- W5: BLE + System ----
  if (!strcmp(path, "/api/ble")) {
    if (isGet) { respondBleJson(); return; }
    if (isPost) { handleBlePost(); return; }
  }
  if (!strcmp(path, "/api/system")) {
    if (isGet) { respondSystemJson(); return; }
    if (isPost) { handleSystemPost(); return; }
  }

  respond404();
}

// --- state machine ----------------------------------------------------
void resetConn() {
  conn.stop();
  conn = WiFiClient();
  state = HttpState::Idle;
  reqLen = hdrLen = bodyLen = contentLen = 0;
  reqLineDone = false;
  authOk = false;
}

void pollIdle() {
  if (!server) return;
  WiFiClient incoming = server->accept();
  if (!incoming) return;
#if WEB_AP_DEBUG
  if (apActive) Serial.println(F("[web-dbg] accepted conn"));
#endif
  conn = incoming;
  state = HttpState::ReadRequest;
  stateEnteredMs = millis();
  reqLen = hdrLen = bodyLen = contentLen = 0;
  reqLineDone = false;
  authOk = false;
}

void maybeStartBody() {
  if (contentLen == 0) { route(); return; }
  if (contentLen >= sizeof(body)) {
    int n = snprintf(jsonBuf, sizeof(jsonBuf), "{\"err\":\"body too large\"}");
    respondJson("413 Payload Too Large", n);
    return;
  }
  state = HttpState::ReadBody;
}

void pollRead() {
  if (!conn.connected() || millis() - stateEnteredMs > kRequestTimeoutMs) {
    resetConn();
    return;
  }
  int budget = 512;
  while (budget-- > 0 && conn.available()) {
    char c = (char)conn.read();
    if (!reqLineDone) {
      if (c == '\n') {
        reqLine[reqLen] = '\0';
        reqLineDone = true;
      } else if (c != '\r' && reqLen < sizeof(reqLine) - 1) {
        reqLine[reqLen++] = c;
      }
      continue;
    }
    if (c == '\n') {
      hdrLine[hdrLen] = '\0';
      if (hdrLen == 0) { maybeStartBody(); return; }
      if (!strncasecmp(hdrLine, "Authorization:", 14)) {
        const char* v = hdrLine + 14;
        while (*v == ' ') v++;
        if (authHeaderMatches(v)) authOk = true;
      } else if (!strncasecmp(hdrLine, "Content-Length:", 15)) {
        contentLen = (size_t)atoi(hdrLine + 15);
      }
      hdrLen = 0;
    } else if (c != '\r' && hdrLen < sizeof(hdrLine) - 1) {
      hdrLine[hdrLen++] = c;
    }
  }
}

void pollReadBody() {
  if (!conn.connected() || millis() - stateEnteredMs > kRequestTimeoutMs) {
    resetConn();
    return;
  }
  int budget = 512;
  while (budget-- > 0 && conn.available() && bodyLen < contentLen) {
    body[bodyLen++] = (char)conn.read();
  }
  if (bodyLen >= contentLen) {
    body[bodyLen] = '\0';
    route();
  }
}

void pollRespond() {
  if (!conn.connected() || millis() - stateEnteredMs > kResponseTimeoutMs) {
    resetConn();
    return;
  }
  if (rspHeadSent < rspHeadLen) {
    rspHeadSent += conn.write((const uint8_t*)rspHead + rspHeadSent,
                              rspHeadLen - rspHeadSent);
    return;
  }
  if (rspBodySent < rspBodyLen) {
    size_t n = rspBodyLen - rspBodySent;
    if (n > kChunk) n = kChunk;
    rspBodySent += conn.write(rspBody + rspBodySent, n);
    return;
  }
  resetConn();  // Connection: close
}

}  // namespace

void webConfigInit() {
  Serial.println(F("[web] init"));  // boot-hang triage marker
  if (!g_settings.webEnable) {
    Serial.println(F("[web] disabled (webenable=0)"));
    return;
  }
  bool dirty = false;
  if (!g_settings.adminPass[0]) {
    genPassword(g_settings.adminPass, 10);
    Serial.println(F("[web] admin password generated (TFT WEB page shows it)"));
    dirty = true;
  }
  if (!g_settings.apPass[0]) {
    genPassword(g_settings.apPass, 10);
    dirty = true;
  }
  if (dirty && !settingsSave())
    Serial.println(F("[web] WARN: passwords not persisted (no SD)"));
  snprintf(apSsid, sizeof(apSsid), "%s-setup", g_settings.hostname);

  WiFi.setHostname(g_settings.hostname);  // applies on the next join
  Serial.println(F("[web] hostname set"));

  static WiFiServer srv(g_settings.webPort);
  server = &srv;
  Serial.print(F("[web] config GUI on :"));
  Serial.println(g_settings.webPort);

  if (g_settings.bootAp) {
    // One-shot AP-at-boot (see webConfigRequestApMode): clear the flag
    // FIRST so any exit — button, power cycle, crash — lands in STA.
    g_settings.bootAp = false;
    settingsSave();
    scanIntoCache();  // the one safe scan window: radio idle, pre-AP
    uint8_t r = WiFi.beginAP(apSsid, g_settings.apPass);
    apActive = (r == WL_AP_LISTENING || r == WL_AP_CONNECTED);
    if (apActive) {
      Serial.print(F("[web] AP provisioning: "));
      Serial.print(apSsid);
      Serial.println(F(" @ 192.168.4.1 (AP button = exit + reboot)"));
    } else {
      Serial.print(F("[web] beginAP FAILED code "));
      Serial.println(r);  // falls through to normal STA operation
    }
  }
}

void webConfigPoll() {
  if (!g_settings.webEnable || !server) return;

  // (int32_t) idiom: `millis() > rebootAtMs` breaks across the 49.7-day
  // wrap (team review L2 — the one non-idiomatic millis() in the tree).
  if (rebootAtMs && (int32_t)(millis() - rebootAtMs) > 0 &&
      state == HttpState::Idle) {
    Serial.println(F("[web] rebooting"));
    Serial.flush();
    sdLoggerShutdown();  // close/sync the .ubx before the reset
    delay(50);
    NVIC_SystemReset();
  }

  uint8_t st = WiFi.status();
  // AP mode: serve unconditionally. nina-fw's status leaks STA events
  // while the AP runs (WL_CONNECTION_LOST observed mid-AP with the AP
  // still beaconing and the phone still joined — bench 2026-07-31), so
  // st is untrustworthy there; the AP doesn't stop by itself and the
  // only exit is our own reboot.
  bool netUp = apActive ? true : (st == WL_CONNECTED);
#if WEB_AP_DEBUG
  // AP-serve triage (2026-07-31: phone joins the AP but HTTP won't
  // connect): 5 s heartbeat of the gate inputs + accept activity.
  static uint32_t dbgMs = 0;
  if (apActive && millis() - dbgMs > 5000) {
    dbgMs = millis();
    Serial.print(F("[web-dbg] st="));
    Serial.print(st);
    Serial.print(F(" netUp="));
    Serial.print(netUp);
    Serial.print(F(" serverUp="));
    Serial.print(serverUp);
    Serial.print(F(" httpState="));
    Serial.println((int)state);
  }
#endif
  if (!netUp) {
    if (serverUp) { serverUp = false; resetConn(); }
    return;
  }
  if (!serverUp) {
    // Team review H3: begin() leaks the previous NINA socket on every
    // rejoin — end() first. (web_config builds only against upstream
    // WiFiNINA, which has end(); see tcp_nmea.cpp for the fork story.)
    server->end();
    server->begin(g_settings.webPort);
    if (server->status() == 0)
      Serial.println(F("[web] WARN: server bind failed (socket table?)"));
    serverUp = true;
    if (apActive) {
      Serial.print(F("[web] serving on http://192.168.4.1/  srvStatus="));
      Serial.println(server->status());
    }
  }

  switch (state) {
    case HttpState::Idle:        pollIdle(); break;
    case HttpState::ReadRequest: pollRead(); break;
    case HttpState::ReadBody:    pollReadBody(); break;
    case HttpState::Respond:     pollRespond(); break;
  }
}

void webConfigRequestApMode() {
  if (!apActive) {
    // BOTH AP transitions are reboots (bench 2026-07-31): switching
    // modes on a live module fails two ways — WiFi.end() wedges STA
    // rejoin, and the NINA's socket table leaks across end() (the STA
    // session's server/client socks are never freed, getSocket starves,
    // the AP-mode bind comes up CLOSED and accept() floods phantom
    // clients). A one-shot bootap flag + reset gives AP mode a freshly
    // reset module with an empty socket table, every time.
    Serial.println(F("[web] AP mode at next boot -> reboot"));
    g_settings.bootAp = true;
    if (!settingsSave()) {
      Serial.println(F("[web] no SD — can't persist bootap; staying in STA"));
      g_settings.bootAp = false;
      return;
    }
    rebootAtMs = millis() + 100;
  } else {
    // Exit provisioning: bootap was already cleared at AP entry, so a
    // plain reboot lands back in STA.
    Serial.println(F("[web] leaving AP mode -> reboot"));
    rebootAtMs = millis() + 100;
  }
}

bool webConfigApRequested() { return apActive; }
bool webConfigApActive() { return apActive; }
const char* webConfigAdminPass() { return g_settings.adminPass; }
const char* webConfigApPass() { return g_settings.apPass; }
const char* webConfigApSsid() { return apSsid; }

#endif  // ENABLE_WEB_CONFIG
